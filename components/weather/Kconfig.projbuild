## components/weather/Kconfig.projbuild
```kconfig
menu "Open-Meteo Weather Configuration"
config PLACE_NAME
    string "Display place name (Chinese subset / Latin)"
    default "成都市郫都区"
    help
        Chinese glyphs are compiled as a subset. For a custom place, add its
        characters to main/fonts/characters.txt and regenerate the font tables.

config LATITUDE
    string "WGS84 latitude"
    default "30.80993"
    help
        Default: Pitong, Pidu District, Chengdu. No API key is required.

config LONGITUDE
    string "WGS84 longitude"
    default "103.88253"

config WEATHER_TIMEZONE
    string "Open-Meteo IANA timezone"
    default "Asia/Shanghai"
    help
        Must match the local POSIX timezone in WT32-ETH01 Configuration.
endmenu
```

## main/Kconfig.projbuild
```kconfig
# put here your custom config value
menu "WiFi Configuration"
config ESP_WIFI_SSID
    string "WiFi SSID"
    default "myssid"
    help
	SSID (network name) for the project to connect to.

config ESP_WIFI_PASSWORD
    string "WiFi Password"
    default "mypassword"
    help
	WiFi password (WPA or WPA2) for the project to use.

config ESP_DNS_NAME
    string "DNS Name"
    default "myweatherdisplay"
    help
	DNS name for the project to use in the network.


endmenu
menu "WT32-ETH01 Configuration"
config EPD_DIAGNOSTIC_MODE
    bool "Screen-only diagnostic (no Wi-Fi, SPI 100 kHz)"
    default n
    help
        Initialize the 4.2-inch G panel and display four color bars once.
        Skip Wi-Fi, weather and ESP32 deep sleep. On failure, allow 60 seconds
        for voltage measurements, then hold panel reset LOW and stop.
        Disable this option to restore the weather display.

config DISPLAY_TIMEZONE
    string "POSIX timezone"
    default "CST-8"
    help
        CST-8 is UTC+8 (China). Uses POSIX rather than IANA timezone syntax.
endmenu
```

## sdkconfig.defaults
```kconfig
CONFIG_IDF_TARGET="esp32"
CONFIG_ESPTOOLPY_FLASHMODE_DIO=y
CONFIG_ESPTOOLPY_FLASHFREQ_40M=y
CONFIG_ESPTOOLPY_FLASHSIZE_4MB=y
CONFIG_PARTITION_TABLE_CUSTOM=y
CONFIG_PARTITION_TABLE_CUSTOM_FILENAME="partitions.csv"
CONFIG_ESP_MAIN_TASK_STACK_SIZE=8192
CONFIG_MBEDTLS_CERTIFICATE_BUNDLE=y
CONFIG_MBEDTLS_CERTIFICATE_BUNDLE_DEFAULT_FULL=y
CONFIG_DISPLAY_TIMEZONE="CST-8"
# CONFIG_ENABLE_OTA_BUTTON is not set
CONFIG_PLACE_NAME="Pidu, Chengdu"
CONFIG_LATITUDE="30.80993"
CONFIG_LONGITUDE="103.88253"
CONFIG_WEATHER_TIMEZONE="Asia/Shanghai"
```
